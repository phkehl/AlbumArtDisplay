/*!
    \file
    \brief flipflip's Album Art Display: system status (noises and LED) (see \ref FF_DISPLAY)

    - Copyright (c) 2018 Philippe Kehl (flipflip at oinkzwurgl dot org),
      https://oinkzwurgl.org/projaeggd/album-art-display
*/

#include <Ticker.h>
#include <SPIFFS.h>
#include <FS.h>
#include <AnimatedGIF.h>
#include <WiFi.h>
#if COVER_ART_URL_IS_HTTPS
#  include <WiFiClientSecure.h>
#else
#  include <WiFiClient.h>
#endif
#include <HTTPClient.h>

#include "stuff.h"
#include "debug.h"
#include "display.h"
#include "wifi.h"
#include "secrets.h"
extern "C" {
#include "nyan_64x32.h"
#include "hsv2rgb.h"
#include "upng.h"
}

/* ****************************************************************************************************************** */

static leddisplay_frame_t sFrame;
static Ticker             sDisplayTicker;
static AnimatedGIF        sAniGif;
static bool               sGifOk;

// ---------------------------------------------------------------------------------------------------------------------

void displayInit(void)
{
    DEBUG("display: init (%dx%d)", LEDDISPLAY_WIDTH, LEDDISPLAY_HEIGHT);

    leddisplay_init();
    leddisplay_set_brightness(50);
    leddisplay_frame_clear(&sFrame);
    leddisplay_frame_fill_rgb(&sFrame, 100, 100, 100);
    for (uint16_t xy = 0; xy < MIN(LEDDISPLAY_WIDTH, LEDDISPLAY_HEIGHT); xy++)
    {
        leddisplay_frame_xy_rgb(&sFrame, xy, xy, 255, 255, 255);
    }
    leddisplay_frame_xy_rgb(&sFrame, 0, 1, 255, 0, 0);
    leddisplay_frame_xy_rgb(&sFrame, 2, 3, 0, 255, 0);
    leddisplay_frame_xy_rgb(&sFrame, 4, 5, 0, 0, 255);
    leddisplay_frame_update(&sFrame);

    sAniGif.begin(LITTLE_ENDIAN_PIXELS);
}

static void sDisplayStop(void)
{
    sDisplayTicker.detach();
    leddisplay_frame_clear(&sFrame);
    leddisplay_frame_update(&sFrame);
}

// ---------------------------------------------------------------------------------------------------------------------

static void sDisplayNoise(void)
{
    // Deliberately not using leddpixel_frame_*() so that we can use sFrame for other purposes, e.g. in displayCoverArt()
    for (uint16_t x = 0; x < LEDDISPLAY_WIDTH; x++)
    {
        for (uint16_t y = 0; y < LEDDISPLAY_WIDTH; y++)
        {
            const uint32_t r = esp_random();
            leddisplay_pixel_xy_rgb(x, y, r, r >> 8, r >> 16);
        }
    }
    leddisplay_pixel_update(0);
}

#define NOISE_INT 50
void displayNoise(const bool enable)
{
    sDisplayStop();
    if (enable)
    {
        DEBUG("display: noise");
        leddisplay_set_brightness(30);
        sDisplayTicker.attach_ms(NOISE_INT, sDisplayNoise);
    }
}

// ---------------------------------------------------------------------------------------------------------------------

typedef struct anim_frame_s
{
    uint8_t yx[32][64][3];
} anim_frame_t;

void sDisplayNyan(void)
{
    // Get animation frame
    int nFrames;
    const uint8_t *animData = get_nyan_64x32(&nFrames);

    // Clear display (fill with nyan cat sky colour)
    //leddisplay_frame_clear(&sFrame);
    leddisplay_frame_fill_rgb(&sFrame, animData[0], animData[1], animData[2]);

    // Copy next frame data to display buffer
    static int frame = 0;
    const anim_frame_t *data = (const anim_frame_t  *)&animData[64 * 32 * 3 * frame];
    for (uint16_t x = 0; x < 64; x++)
    {
        for (uint16_t y = 0; y < 32; y++)
        {
            const uint8_t *rgb = data->yx[y][x];
            leddisplay_frame_xy_rgb(&sFrame, x, y + 16, rgb[0], rgb[1], rgb[2]);
        }
    }
    frame++;
    frame %= nFrames;

    // Display
    leddisplay_frame_update(&sFrame);
}

void displayNyan(const bool enable)
{
    sDisplayStop();
    if (enable)
    {
        DEBUG("display: nyan");
        leddisplay_set_brightness(35);
        sDisplayTicker.attach_ms(125, sDisplayNyan);
    }
}

// ---------------------------------------------------------------------------------------------------------------------

bool displayCoverArt(const char *playerId)
{
    if (playerId == NULL)
    {
        sDisplayStop();
        return false;
    }

    // Switch to noise display, so that sFrame becomes free to use here
    displayNoise(true);

    DEBUG("display: coverart (%s)", playerId);

    const int rgbSize = sizeof(sFrame.raw);

    char coverArtUrl[sizeof(COVER_ART_URL) + 50];
    snprintf(coverArtUrl, sizeof(coverArtUrl), "%s?player=%s", COVER_ART_URL, playerId);
    const uint32_t t0 = millis();

    DEBUG("display: get %s", coverArtUrl);
    int resSize = 0;
    {
        HTTPClient http;
#if COVER_ART_URL_IS_HTTPS
        WiFiClientSecure client; // https://
#else
        WiFiClient client; // http://
#endif

        http.setUserAgent(wifiUserAgentStr());
        http.setTimeout(5000); // [ms]
        //http.setFollowRedirects(true);
        //http.setRedirectLimit(5);
        // #if defined(ESP8266)
        //     client.setInsecure();
        //     client.setBufferSizes(4096, 2048); // FIXME: good? seems to work fine...
        //     client.setTimeout(10000); // [ms]
        // #endif

        if (!http.begin(client, coverArtUrl))
        {
            WARNING("display: failed to connect!");
            http.end();
            client.stop();
            return false;
        }

        DEBUG("display: GET start (dt=%u)", millis() - t0);
        const int respStatus = http.GET();
        const int respSize = http.getSize();
        
        if ( (respStatus < 0) || (respStatus != HTTP_CODE_OK) )
        {
            WARNING("display: GET fail (status=%d, size=%d) %s (dt=%u)", respStatus, respSize,
                respStatus < 0 ? http.errorToString(respStatus).c_str() : PSTR("unexpected response status"),
                millis() - t0);
            http.end();
            client.stop();
            return false;
        }

        DEBUG("display: GET okay (status=%d, size=%d) (dt=%u)", respStatus, respSize, millis() - t0);

        // Get data, into sFrame.raw buffer, assuming PNG is smaller than unpacked image...
        int remSize = MIN(respSize, rgbSize);
        while ( http.connected() && (remSize > 0) )
        {
            const int sizeAvail = client.available();
            if (sizeAvail > 0)
            {
                const int sizeRead = sizeAvail > remSize ? remSize : sizeAvail;
                const int dataSize = client.readBytes(&sFrame.raw[resSize], sizeRead);
                resSize += dataSize;
                remSize -= dataSize;
                DEBUG("display: GET received %d/%d bytes, have now %d, remaining %d (dt=%u)",
                    sizeRead, sizeAvail, resSize, remSize, millis() - t0);
            }
            else
            {
                delay(111);
            }
        }

        DEBUG("display: GET done (dt=%u)", millis() - t0);
        http.end();
        client.stop();
    }

    bool pngOk = true;
    upng_t *png = upng_new_from_bytes(sFrame.raw, resSize);
    if (png == NULL)
    {
        ERROR("display: png malloc (1)");
        return false;
    }

    const upng_error err = upng_decode(png);

    if (err == UPNG_EOK)
    {
        const unsigned int width = upng_get_width(png);
        const unsigned int height = upng_get_height(png);
        const enum upng_format format = upng_get_format(png);
        DEBUG("display: GET: png: %ux%u format=%u", width, height, format);
        if ( (format == UPNG_RGBA8) && ( (width * height * 3) == rgbSize) )
        {
            const uint8_t *in = upng_get_buffer(png);
            uint8_t *out = sFrame.raw;
            resSize = 0;
            while (resSize < rgbSize)
            {
                *out = *in; in++; out++; // copy R
                *out = *in; in++; out++; // copy G
                *out = *in; in++; out++; // copy B
                in++; // skip A
                resSize += 3; // RGB
            }
        }
        upng_free(png);
    }
    else if (err == UPNG_ENOMEM)
    {
        ERROR("display: png malloc (2)");
        upng_free(png);
        return false;
    }
    else
    {
        ERROR("display: Bad png?! %d", err);
        upng_free(png);
        return false;
    }

    DEBUG("display: cover art ok, %d/%d bytes (dt=%u)", resSize, rgbSize, millis() - t0);

    // Stop noise, wait until leddisplay frame buffer becomes available
    sDisplayTicker.detach();
    delay((NOISE_INT * 3) / 2);
    
    // Put cover art on display
    leddisplay_set_brightness(50);
    leddisplay_frame_update(&sFrame);
    return true;
}

// ---------------------------------------------------------------------------------------------------------------------

void displayTest(void)
{
    sDisplayStop();
    leddisplay_set_brightness(50);

    PRINT("test red");
    leddisplay_frame_clear(&sFrame);
    leddisplay_frame_fill_rgb(&sFrame, 255, 0, 0);
    leddisplay_frame_update(&sFrame);
    delay(1000);

    PRINT("test green");
    leddisplay_frame_clear(&sFrame);
    leddisplay_frame_fill_rgb(&sFrame, 0, 255, 0);
    leddisplay_frame_update(&sFrame);
    delay(1000);

    PRINT("test blue");
    leddisplay_frame_clear(&sFrame);
    leddisplay_frame_fill_rgb(&sFrame, 0, 0, 255);
    leddisplay_frame_update(&sFrame);
    delay(1000);

    PRINT("test red green blue");
    for (uint16_t y = 0; y < LEDDISPLAY_HEIGHT; y++)
    {
        const uint8_t m = y % 3;
        const uint8_t r = m == 0 ? 255 :0;
        const uint8_t g = m == 1 ? 255 :0;
        const uint8_t b = m == 2 ? 255 :0;
        for (uint16_t x = 0; x < LEDDISPLAY_WIDTH; x++)
        {
            leddisplay_frame_xy_rgb(&sFrame, x, y, r, g, b);
        }
    }
    leddisplay_frame_update(&sFrame);
    delay(5000);
}

// ---------------------------------------------------------------------------------------------------------------------

static const uint8_t rgberset[64*64] =
{
    0x03, 0x03, 0x03, 0x03, 0x03, 0x03, 0x03, 0x03, 0x03, 0x03, 0x03, 0x03,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 0x03,
    0x03, 0x03, 0x03, 0x03, 0x03, 0x03, 0x03, 0x03, 0x03, 0x03, 0x03, 0x03,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 0x03,
    0x03, 0x03, 0x03, 0x03, 0x03, 0x03, 0x03, 0x03, 0x03, 0x03, 0x03, 0x03,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 0x03,
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    0x03, 0x03, 0x03, 0x03, 0x03, 0x03, 0x03, 0x03, 0x03, 0x03, 0x03, 0x03,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 0x03,
};

static void sDisplayRGBerset(void)
{
    static int hueIx;
    static const uint8_t hues[] =
    {
          0,   0,   0,   0,   0,   0,   0,   0,   0,   0,   0,   0,   0,   0,   0,   0,   0,   0,
          8,  12,  16,  20,  24,  28,  32,  36,  40,  44,  48,  52,  56,  60,  64,  68,  72,  76,
         85,  85,  85,  85,  85,  85,  85,  85,  85,  85,  85,  85,  85,  85,  85,  85,  85,  85,
         90,  94,  98, 102, 106, 110, 114, 118, 122, 126, 130, 134, 138, 142, 146, 150, 154, 158,
        160, 160, 160, 160, 160, 160, 160, 160, 160, 160, 160, 160, 160, 160, 160, 160, 160, 160,
        165, 170, 175, 180, 185, 190, 195, 200, 205, 210, 215, 220, 225, 230, 235, 240, 245, 250,
    };
    const uint8_t hue = hues[hueIx];
    hueIx++;
    hueIx %= NUMOF(hues);
    uint16_t ix = 0;
    for (uint16_t x = 0; x < LEDDISPLAY_WIDTH; x++)
    {
        for (uint16_t y = 0; y < LEDDISPLAY_WIDTH; y++)
        {
            const uint8_t rgb = rgberset[ix++];
            uint8_t r, g, b;
            hsv2rgb(hue, 255, rgb, &r, &g, &b);
            sFrame.yx[y][x][0] = r;
            sFrame.yx[y][x][1] = g;
            sFrame.yx[y][x][2] = b;
        }
    }
    leddisplay_frame_update(&sFrame);
}

void displayRGBerset(const bool enable)
{
    sDisplayStop();
    if (enable)
    {
        DEBUG("display: rgberset");
        leddisplay_set_brightness(40);
        sDisplayTicker.attach_ms(100, sDisplayRGBerset);
    }
}

// ---------------------------------------------------------------------------------------------------------------------

// Routines from https://github.com/bitbank2/AnimatedGIF/blob/master/examples/adafruit_gfx_sdcard/adafruit_gfx_sdcard.ino

static void *sGifOpen(const char *fname, int32_t *pSize)
{
    static File sGifFile;
    sGifFile = SPIFFS.open(fname);
    if (sGifFile)
    {
        *pSize = sGifFile.size();
        return (void *)&sGifFile;
    }
    return NULL;
}

static void sGifClose(void *pHandle)
{
    File *f = static_cast<File *>(pHandle);
    if (f != NULL)
    {
        f->close();
    }
} 

static int32_t sGifRead(GIFFILE *pFile, uint8_t *pBuf, int32_t iLen)
{
    int32_t iBytesRead;
    iBytesRead = iLen;
    File *f = static_cast<File *>(pFile->fHandle);
    // Note: If you read a file all the way to the last byte, seek() stops working
    if ((pFile->iSize - pFile->iPos) < iLen)
    {
       iBytesRead = pFile->iSize - pFile->iPos - 1; // <-- ugly work-around
    }
    if (iBytesRead <= 0)
    {
       return 0;
    }
    iBytesRead = (int32_t)f->read(pBuf, iBytesRead);
    pFile->iPos = f->position();
    return iBytesRead;
}

static int32_t sGifSeek(GIFFILE *pFile, int32_t iPosition)
{ 
    // int i = micros();
    File *f = static_cast<File *>(pFile->fHandle);
    f->seek(iPosition);
    pFile->iPos = (int32_t)f->position();
    //i = micros() - i;
    //Serial.printf("Seek time = %d us\n", i);
    return pFile->iPos;
}

static void sGifDrawPixel(const uint16_t x, const uint16_t y, const uint16_t rgb585)
{
    const uint16_t r5 = (rgb585 & 0xf800) >> 11;
    const uint16_t g6 = (rgb585 & 0x07e0) >>  5;
    const uint16_t b5 = (rgb585 & 0x001f);
    const uint8_t r8 = ((r5 * 527) + 23 ) >> 6;
    const uint8_t g8 = ((g6 * 259) + 33 ) >> 6;
    const uint8_t b8 = ((b5 * 527) + 23 ) >> 6;
    sFrame.yx[y][x][0] = r8;
    sFrame.yx[y][x][1] = g8;
    sFrame.yx[y][x][2] = b8;
}

static void sGifDraw(GIFDRAW *pDraw)
{
    // The following "code" is from https://github.com/bitbank2/AnimatedGIF/blob/master/examples/

    // DEBUG("sGifDraw() iX=%d iY=%d y=%d iW=%d tr=%d %d disp=%d bg=%u", pDraw->iX, pDraw->iY, pDraw->y, pDraw->iWidth,
    //     pDraw->ucTransparent, pDraw->ucHasTransparency, pDraw->ucDisposalMethod, pDraw->ucBackground);

    const uint16_t *usPalette = pDraw->pPalette;
    const int y = pDraw->iY + pDraw->y; // current line
    
    uint8_t *pixels = pDraw->pPixels;
    if (pDraw->ucDisposalMethod == 2) // restore to background color
    {
        for (int ix = 0; ix < pDraw->iWidth; ix++)
        {
            if (pixels[ix] == pDraw->ucTransparent)
            {
                pixels[ix] = pDraw->ucBackground;
            }
        }
        pDraw->ucHasTransparency = 0;
    }

    // Apply the new pixels to the main image
    if (pDraw->ucHasTransparency) // if transparency used
    {
        const uint8_t ucTransparent = pDraw->ucTransparent;
        const uint8_t *pEnd = pixels + pDraw->iWidth;
        int x = 0;
        int iCount = 0; // count non-transparent pixels
        uint8_t c;
        while(x < pDraw->iWidth)
        {
            c = ucTransparent-1;
            static uint16_t usTemp[320]; // too much stack!
            uint16_t *d = usTemp;
            while (c != ucTransparent && pixels < pEnd)
            {
                c = *pixels++;
                if (c == ucTransparent) // done, stop
                {
                    pixels--; // back up to treat it like transparent
                }
                else // opaque
                {
                    *d++ = usPalette[c];
                    iCount++;
                }
            } // while looking for opaque pixels
            if (iCount) // any opaque pixels?
            {
                for (int xOffset = 0; xOffset < iCount; xOffset++ )
                {
                    sGifDrawPixel(pDraw->iX + x + xOffset, y, usTemp[xOffset]);
                }
                x += iCount;
                iCount = 0;
            }
            // no, look for a run of transparent pixels
            c = ucTransparent;
            while (c == ucTransparent && pixels < pEnd)
            {
                c = *pixels++;
                if (c == ucTransparent)
                {
                    iCount++;
                }
                else
                {
                    pixels--; 
                }
            }
            if (iCount)
            {
                x += iCount; // skip these
                iCount = 0;
            }
        }
    }
    else
    {
        pixels = pDraw->pPixels;
        // Translate the 8-bit pixels through the RGB565 palette (already byte reversed)
        // for (x = 0; x < pDraw->iWidth; x++)
        // {
        //     sGifDrawPixel(pDraw->iX + x, y, usPalette[*pixels++]);
        // }
        uint16_t x = pDraw->iX;
        for (int ix = 0; ix < pDraw->iWidth; ix++, x++)
        {
            sGifDrawPixel(x, y, usPalette[pixels[ix]]);
        }
    }
}

static void sDisplayGif(void)
{
    static int frameDur;
    const int res = sAniGif.playFrame(false, &frameDur);
    if (res < 0)
    {
        ERROR("gif decode: %d", sAniGif.getLastError());
        displayNoise(true);
        sGifOk = false;
        return;
    }

    leddisplay_frame_update(&sFrame);
    //DEBUG("gif frame %d", frameDur);
    //sDisplayTicker.once_ms(frameDur, sDisplayGif);

    if (res == 0)
    {
        //DEBUG("gif done");
        //sAniGif.close();
        const uint32_t t0 = millis();
        sAniGif.reset();
        const uint32_t dt = millis() - t0;
        if (frameDur > dt)
        {
            frameDur -= dt;
        }
        else
        {
            frameDur = 1;
        }
    }
    if (frameDur <= 5)
    {
        frameDur = 5;
    }
    else if (frameDur > 1000)
    {
        frameDur = 1000;
    }
    sDisplayTicker.once_ms(frameDur, sDisplayGif);
}

void displayGif(const char *file)
{
    if (file == NULL)
    {
        sDisplayStop();
        sAniGif.close();
        return;
    }

    sGifOk = true;
    displayNoise(true);
    sAniGif.close();
    DEBUG("display: gif (%s)", file);
    GIFINFO info;
    if (sAniGif.open(file, sGifOpen, sGifClose, sGifRead, sGifSeek, sGifDraw) && sAniGif.getInfo(&info))
    {
        DEBUG("display: %s: %dx%d, %d frames, %dms (%d..%d)", file,
            sAniGif.getCanvasWidth(), sAniGif.getCanvasHeight(),
            info.iFrameCount, info.iDuration, info.iMinDelay, info.iMaxDelay);
        sDisplayTicker.once_ms(10, sDisplayGif);
    }
    else
    {
        ERROR("display: gif %s fail", file);
        sGifOk = false;
    }
}

bool displayGifOk(void)
{
    const bool res = sGifOk;
    sGifOk = true;
    return res;
}

/* ****************************************************************************************************************** */
// eof
